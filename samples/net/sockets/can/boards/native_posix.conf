## samples/net/sockets/can/boards/native_posix.conf
```kconfig
CONFIG_CAN_NATIVE_POSIX=y
CONFIG_ETH_NATIVE_POSIX=n
CONFIG_NET_SOCKETS_CAN=y
CONFIG_LOG_BACKEND_NATIVE_POSIX=y
CONFIG_LOG_DEFAULT_LEVEL=3
CONFIG_CAN_LOG_LEVEL_DBG=y
```
